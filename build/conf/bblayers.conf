## build/conf/bblayers.conf
```bitbake
# LAYER_CONF_VERSION is increased each time build/conf/bblayers.conf
# changes incompatibly
LCONF_VERSION = "7"

BBPATH = "${TOPDIR}"
BBFILES ?= ""

BBLAYERS ?= " \
  /media/expansiondrive/de1-bsp-yocto/layers/openembedded-core/meta \
  /media/expansiondrive/de1-bsp-yocto/layers/meta-intel-fpga \
  /media/expansiondrive/de1-bsp-yocto/layers/meta-de1-soc \
  /media/expansiondrive/de1-bsp-yocto/build/workspace \
  "
```
